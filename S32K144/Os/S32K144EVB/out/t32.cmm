; --------------------------------------------------------------------------------
; @Title: Script for S32K144
; @Description:
;   Loads application into MCU internal RAM and sets up a debug scenario.

WinCLEAR

; --------------------------------------------------------------------------------
; initialize and start the debugger

RESet
SYStem.RESet
SYStem.CPU S32K144
SYStem.CONFIG.DEBUGPORTTYPE SWD
IF COMBIPROBE()||UTRACE()
(
  SYStem.CONFIG.CONNECTOR MIPI20T
)
SYStem.Option DUALPORT ON
SYStem.MemAccess DAP
SYStem.JtagClock CTCK 10MHz
Trace.DISable
SYStem.Up

; disable BootROM
GOSUB DisableBootrom
; disable Watchdog
GOSUB DisableWatchdog

; --------------------------------------------------------------------------------
; load demo program (uses internal RAM only)
Data.LOAD.Elf "~~~~/erika3app.elf"


TASK.ORTI system.orti

Break.Set TASK.CONFIG(magic) /Write /TraceData
Break.Set TASK.CONFIG(magic_service) /Write /TraceData

; Markers provided by Marco Ferrario
y.marker.res
y.marker.c IGNORE osEE_change_context_from_task_end
y.marker.c IGNORE osEE_cortex_m_change_context_from_task_end
; y.marker.c IGNORE osEE_scheduler_task_end
y.marker.c IGNORE osEE_scheduler_task_wrapper_run
y.marker.c IGNORE osEE_scheduler_task_not_terminated
y.marker.c IGNORE osEE_scheduler_task_terminated
y.marker.c IGNORE osEE_scheduler_task_terminated+0x48
; y.marker.c IGNORE osEE_cortex_m_switch_context
; y.marker.c IGNORE osEE_cortex_m_switch_context+0x0e
y.marker.c IGNORE osEE_change_context_from_running
y.marker.c IGNORE osEE_change_context_from_running+26
y.marker.c IGNORE osEE_scheduler_task_wrapper_restore
y.marker.c IGNORE osEE_scheduler_core_pop_running
y.marker.c IGNORE osEE_scheduler_core_pop_running+0x20
; y.marker.c IGNORE osEE_scheduler_stk_next
; y.marker.c IGNORE osEE_scheduler_stk_next+0x1c
; y.marker.c IGNORE osEE_scheduler_core_rq_preempt_stk
; y.marker.c IGNORE osEE_scheduler_core_rq_preempt_stk+0x52
y.marker.c CLEANUP TerminateTask
y.marker.c FEXITDOUBLE SVC_Handler+2

; --------------------------------------------------------------------------------
; start program execution
Go.direct main
WAIT !STATE.RUN()

; --------------------------------------------------------------------------------
; open some windows
WinCLEAR
Mode.Hll
WinPOS 0. 0. 116. 26.
List.auto
WinPOS 120. 0. 100. 8.
Frame.view
WinPOS 120. 14.
Var.Watch
;Var.AddWatch %SpotLight ast flags
WinPOS 120. 25.
Register.view /SpotLight
;WinPOS 0. 32.
;Var.DRAW %DEFault sinewave

ENDDO

; --------------------------------------------------------------------------------

DisableBootrom:
(
  Data.Set SD:0x4007F010 %LE %Long 0x6
  Data.Set SD:0x4007F014 %LE %Long 0x0
  RETURN
)

DisableWatchdog:
(
  LOCAL &tmp1 &tmp2
  &tmp1=Data.Long(ST:0x20000000)
  &tmp2=Data.Long(ST:0x20000004)
  Register.SWAP
  ; The watchdog has a restrictive timing. It has to be configured and unlocked within a peripod
  ; of 128 cycles. Therefor the unlock sequence need to be done by a small target program.
  Data.Assemble ST:0x20000000  str  r1,[r0]  ;SD:0x40052004 = 0xD928C520   (Key)
  Data.Assemble ,              str  r3,[r2]  ;SD:0x40052000 = 0x00002120   (Control register)
  Data.Assemble ,              str  r5,[r4]  ;SD:0x40052008 = 0x0000FFFF   (Timeout value)
  Data.Assemble ,              bkpt #0
  Register.Set PC 0x20000000
  Register.Set SP 0x20001000
  Register.Set R0 0x40052004
  Register.Set R1 0xD928C520
  Register.Set R2 0x40052000
  Register.Set R3 0x00002120
  Register.Set R4 0x40052008
  Register.Set R5 0x0000FFFF
  Go.direct
  WAIT !RUN()

  Data.Set ST:0x20000000 %Long &tmp1
  Data.Set ST:0x20000004 %Long &tmp2
  Register.SWAP

  RETURN
)

